## crates/loader/xtask/src/ci/u-boot/boot.its
```
/dts-v1/;

/ {
    description = "Script to boot Hermit on QEMU virt";

    images {
        default = "script-1";

        script-1 {
            data = /incbin/("./boot.txt");
            type = "script";
            compression = "none";
            hash {
                algo = "sha256";
            };
        };
    };
};
```

## crates/loader/xtask/src/ci/u-boot/hermit.its
```
/dts-v1/;

/ {
    description = "Hermit FIT image";
    #address-cells = <1>;

    images {
        kernel-1 {
            description = "Hermit Loader";
            data = /incbin/("../../../../target/boot/hermit-loader");
            type = "kernel";
            arch = "arm64";
            os = "elf";
            compression = "none";
            load = <0x41000000>;
            entry = <0x41000000>;
            hash {
                algo = "sha256";
            };
        };

        ramdisk-1 {
            description = "Hermit Kernel";
            data = /incbin/("../../../../target/boot/hermit-app");
            type = "ramdisk";
            arch = "arm64";
            os = "elf";
            compression = "none";
            load = <0x48000000>;
            entry = <0x48000000>;
            hash {
                algo = "sha256";
            };
        };
    };

    configurations {
        default = "conf-1";

        conf-1 {
            description = "Boot Hermit Loader with Kernel as ramdisk";
            kernel = "kernel-1";
            ramdisk = "ramdisk-1";
        };
    };
};
```
